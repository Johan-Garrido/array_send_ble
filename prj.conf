## CMakeLists.txt
```
# SPDX-License-Identifier: Apache-2.0

cmake_minimum_required(VERSION 3.13.1)

find_package(Zephyr REQUIRED HINTS $ENV{ZEPHYR_BASE})
project(array_send_ble)

target_sources(app PRIVATE src/main.c
src/bluetooth.c)
```

## sample.yaml
```
sample:
  description: minimal sample, the smallest possible Zephyr application
  name: array_send_ble
common:
  tags: footprint
tests:
  sample.minimal.mt.arm:
    build_only: true
    extra_args: CONF_FILE='common.conf;mt.conf;arm.conf'
    platform_allow: reel_board frdm_k64f mps2_an385 nrf51dk_nrf51422 nucleo_f429zi disco_l475_iot1
  sample.minimal.mt-no-preempt.arm:
    build_only: true
    extra_args: CONF_FILE='common.conf;mt.conf;no-preempt.conf;arm.conf'
    platform_allow: reel_board frdm_k64f mps2_an385 nrf51dk_nrf51422 nucleo_f429zi disco_l475_iot1
  sample.minimal.mt-no-preempt-no-timers.arm:
    build_only: true
    extra_args: CONF_FILE='common.conf;mt.conf;no-preempt.conf;no-timers.conf;arm.conf'
    platform_allow: reel_board frdm_k64f mps2_an385 nrf51dk_nrf51422 nucleo_f429zi disco_l475_iot1
  sample.minimal.no-mt.arm:
    build_only: true
    extra_args: CONF_FILE='common.conf;no-mt.conf;arm.conf'
    platform_allow: reel_board frdm_k64f mps2_an385 nrf51dk_nrf51422 nucleo_f429zi disco_l475_iot1
  sample.minimal.no-mt-no-timers.arm:
    build_only: true
    extra_args: CONF_FILE='common.conf;no-mt.conf;no-timers.conf;arm.conf'
    platform_allow: reel_board frdm_k64f mps2_an385 nrf51dk_nrf51422 nucleo_f429zi disco_l475_iot1
  sample.minimal.mt.x86:
    build_only: true
    extra_args: CONF_FILE='common.conf;mt.conf;x86.conf'
    platform_allow: qemu_x86
  sample.minimal.mt-no-preempt.x86:
    build_only: true
    extra_args: CONF_FILE='common.conf;mt.conf;no-preempt.conf;x86.conf'
    platform_allow: qemu_x86
  sample.minimal.mt-no-preempt-no-timers.x86:
    build_only: true
    extra_args: CONF_FILE='common.conf;mt.conf;no-preempt.conf;no-timers.conf;x86.conf'
    platform_allow: qemu_x86
  sample.minimal.no-mt.x86:
    build_only: true
    extra_args: CONF_FILE='common.conf;no-mt.conf;x86.conf'
    platform_allow: qemu_x86
  sample.minimal.no-mt-no-timers.x86:
    build_only: true
    extra_args: CONF_FILE='common.conf;no-mt.conf;no-timers.conf;x86.conf'
    platform_allow: qemu_x86
```

## prj.conf
```kconfig
CONFIG_BT=y
CONFIG_BT_PERIPHERAL=y
CONFIG_BT_SMP=y
CONFIG_TINYCRYPT=y
CONFIG_BT_DEVICE_NAME="BLE array send"
CONFIG_BT_DIS=y
CONFIG_BT_DIS_PNP=n
CONFIG_BT_BAS=y
CONFIG_BT_DEVICE_APPEARANCE=768
CONFIG_MAIN_STACK_SIZE=4096
```

## src/main.c
```c
/*
 * Copyright (c) 2019 Nordic Semiconductor ASA
 *
 * SPDX-License-Identifier: Apache-2.0
 */

#include <zephyr.h>
#include <sys/printk.h>
#include <stdio.h>
#include <stdlib.h>
#include <bluetooth/bluetooth.h>
#include <bluetooth/hci.h>
#include <bluetooth/conn.h>
#include <bluetooth/uuid.h>
#include <bluetooth/gatt.h>
#include <zephyr/types.h>
#include <settings/settings.h>
#include <stddef.h>
#include <string.h>
#include <errno.h>
#include <sys/byteorder.h>
#include <soc.h>
#include "bluetooth.h"
#define DEVICE_NAME     CONFIG_BT_DEVICE_NAME
#define DEVICE_NAME_LENGTH     (sizeof(DEVICE_NAME) -1)
uint8_t data[2] = {0, 10};

static const struct bt_data ad[] = {
	BT_DATA_BYTES(BT_DATA_FLAGS, (BT_LE_AD_GENERAL | BT_LE_AD_NO_BREDR)),
	BT_DATA(BT_DATA_NAME_COMPLETE, DEVICE_NAME, DEVICE_NAME_LENGTH),
};

static const struct bt_data sd[] = {
	BT_DATA_BYTES(BT_DATA_UUID128_ALL, BT_UUID_DATA_VAL),
};


static void connected(struct bt_conn *conn, uint8_t err)
{
	if (err) {
		printk("Connection failed (err %u)\n", err);
		return;
	}

	printk("Connected\n");

}

static void disconnected(struct bt_conn *conn, uint8_t reason)
{
	printk("Disconnected (reason %u)\n", reason);

}
static struct bt_conn_cb conn_callbacks = {
	.connected        = connected,
	.disconnected     = disconnected,
};


static uint8_t* app_data_cb(void)
{
	return &data;
}

static struct bt_dataService_cb data_callbacs = {
	.data_cb    = app_data_cb,
};

void main(void)
{
  
	int err;
  
  bt_conn_cb_register(&conn_callbacks);

    err = bt_enable(NULL);
    if (err) {
      printk("Bluetooth init failed (err %d)\n", err);
      return;
    }

    printk("Bluetooth initialized\n");

    if (IS_ENABLED(CONFIG_SETTINGS)) {
      settings_load();
    }

    err = bt_dataService_init(&data_callbacs);
    if (err) {
      printk("Failed to init LBS (err:%d)\n", err);
      return;
    }

    err = bt_le_adv_start(BT_LE_ADV_CONN, ad, ARRAY_SIZE(ad),
              sd, ARRAY_SIZE(sd));
    if (err) {
      printk("Advertising failed to start (err %d)\n", err);
      return;
    }

    printk("Advertising successfully started\n");

 while(1){
     data[0]++;
     data[1]++;
     printk("Data %i %i\n", data[0], data[1]);
     bt_send_data_value(data);
     k_sleep(K_SECONDS(2));
 }
}
```

## src/bluetooth.c
```c
#include <sys/printk.h>
#include <zephyr.h>
#include <zephyr/types.h>

#include "bluetooth.h"
#include <bluetooth/bluetooth.h>
#include <bluetooth/hci.h>
#include <bluetooth/conn.h>
#include <bluetooth/uuid.h>
#include <bluetooth/gatt.h>
#include <logging/log.h>

static struct bt_dataService_cb dataService_cb;
static                         uint8_t* data;
static bool                   notify_enabled;
static void lbslc_ccc_cfg_changed(const struct bt_gatt_attr *attr,
				  uint16_t value)
{
	notify_enabled = (value == BT_GATT_CCC_NOTIFY);
}

static ssize_t read_button(struct bt_conn *conn,
			  const struct bt_gatt_attr *attr,
			  void *buf,
			  uint16_t len,
			  uint16_t offset)
{
	const char *value = attr->user_data;

//	LOG_DBG("Attribute read, handle: %u, conn: %p", attr->handle, conn);

	if (dataService_cb.data_cb) {
		data = dataService_cb.data_cb();
		//memcpy(data, buf, len);
		return bt_gatt_attr_read(conn, attr, buf, len, offset, value,
					 sizeof(*value));
	}

	return 0;
}

BT_GATT_SERVICE_DEFINE(data_svc,
	BT_GATT_PRIMARY_SERVICE(BT_UUID_ESS),
	BT_GATT_CHARACTERISTIC(BT_UUID_DATA,
			       BT_GATT_CHRC_READ | BT_GATT_CHRC_NOTIFY,
			       BT_GATT_PERM_READ, read_button, NULL,
			       &data),
        BT_GATT_CCC(lbslc_ccc_cfg_changed,
                               BT_GATT_PERM_READ | BT_GATT_PERM_WRITE),
);

int bt_dataService_init(struct bt_dataService_cb *callbacks)
{
	if (callbacks) {
		dataService_cb.data_cb = callbacks->data_cb;
	}

	return 0;
}
int bt_send_data_value(uint8_t* data)
{
	if (!notify_enabled) {
		return -EACCES;
	}
        //printk("Data %i\n", *data);
	return bt_gatt_notify(NULL, &data_svc.attrs[2],
			      data,
			      sizeof(data));
}
```

## src/bluetooth.h
```c
#include <zephyr/types.h>

//UUID service declaration
#define BT_UUID_SERVICE_VAL BT_UUID_128_ENCODE(0x00001526, 0x1212, 0xefde, 0x1523, 0x785feabcd123)
#define BT_UUID_SERVICE BT_UUID_DECLARE_128 (BT_UUID_SERVICE_VAL)

//UUID data characteristic declaration
#define BT_UUID_DATA_VAL BT_UUID_128_ENCODE(0x00001527, 0x1212, 0xefde, 0x1523, 0x785feabcd123)
#define BT_UUID_DATA BT_UUID_DECLARE_128 (BT_UUID_DATA_VAL)

//Callback declaration
typedef uint8_t* (*data_cb_t) (void);
struct bt_dataService_cb{data_cb_t data_cb;};

int bt_dataService_init (struct bt_dataService_cb *callbacks);
int bt_send_data_value(uint8_t* data);
```
